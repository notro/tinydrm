## Kconfig
```kconfig
menuconfig DRM_TINYDRM
	tristate "Support for small TFT LCD display modules"
	depends on DRM
	select DRM_KMS_HELPER
	select DRM_KMS_CMA_HELPER
	select DRM_GEM_CMA_HELPER
	select DRM_PANEL
	select VIDEOMODE_HELPERS
	help
	  Choose this option if you have a tinydrm supported display.
	  If M is selected the module will be called tinydrm.

config TINYDRM_MIPI_DBI
	tristate

config TINYDRM_ADAFRUIT_TFT
	tristate "DRM driver for Adafruit SPI TFT displays"
	depends on DRM_TINYDRM && SPI
	select LCDREG_SPI
	select TINYDRM_MIPI_DBI
	help
	  DRM driver for the following Adafruit displays:
	    2.8" PiTFT 320x240 for Raspberry Pi - ILI9340 (#1601)
	    2.2" Color TFT LCD display - HX8340BN, 9-bit mode (#797)
	    1.8" Color TFT LCD display - ST7735R (#358)

source "drivers/gpu/drm/tinydrm/lcdreg/Kconfig"
```

## lcdreg/Kconfig
```kconfig
config LCDREG
	tristate
	depends on GPIOLIB || COMPILE_TEST

config LCDREG_I2C
	tristate
	depends on I2C
	select LCDREG

config LCDREG_SPI
	tristate
	depends on SPI
	select LCDREG
```
